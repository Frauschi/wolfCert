## CMakeLists.txt
```
# SPDX-License-Identifier: GPL-3.0-or-later
cmake_minimum_required(VERSION 3.20.0)

find_package(Zephyr REQUIRED HINTS $ENV{ZEPHYR_BASE})
project(wolfcert_est_client)

target_sources(app PRIVATE src/main.c)

if(CONFIG_WOLFCERT_SAMPLE_CA_CERT STREQUAL "")
  set(wolfcert_ca_cert "${ZEPHYR_WOLFCERT_MODULE_DIR}/examples/certs/ecc/ca-cert.pem")
else()
  get_filename_component(wolfcert_ca_cert "${CONFIG_WOLFCERT_SAMPLE_CA_CERT}"
    ABSOLUTE BASE_DIR "${CMAKE_CURRENT_SOURCE_DIR}")
endif()
if(NOT EXISTS "${wolfcert_ca_cert}" OR IS_DIRECTORY "${wolfcert_ca_cert}")
  message(FATAL_ERROR
    "trust anchor ${wolfcert_ca_cert} is not a file")
endif()

generate_inc_file_for_target(app "${wolfcert_ca_cert}"
  "${ZEPHYR_BINARY_DIR}/include/generated/est_ca_cert.inc")

# The sample sets the clock to when CMake last configured.
string(TIMESTAMP wolfcert_build_epoch "%s" UTC)
target_compile_definitions(app PRIVATE
  WOLFCERT_SAMPLE_EPOCH=${wolfcert_build_epoch})
```

## Kconfig
```
# SPDX-License-Identifier: GPL-3.0-or-later

mainmenu "wolfCert EST client sample"

menu "wolfCert EST client sample"

# zephyr/README.md (EST client sample) describes each option.

config WOLFCERT_SAMPLE_EST_URL
	string "EST server URL"
	default "https://10.0.2.2:8443/.well-known/est"

config WOLFCERT_SAMPLE_EST_USER
	string "EST HTTP Basic user name"
	default "alice"

config WOLFCERT_SAMPLE_EST_PASS
	string "EST HTTP Basic password"
	default "hunter2"

config WOLFCERT_SAMPLE_SUBJECT
	string "Certificate subject"
	default "CN=zephyr-device"

config WOLFCERT_SAMPLE_CA_CERT
	string "Trust anchor PEM file"
	default ""

endmenu

source "Kconfig.zephyr"
```

## sample.yaml
```
sample:
  name: wolfCert EST client
  description: Enroll a certificate over EST from a Zephyr target
common:
  tags:
    - wolfcert
  harness: console
  harness_config:
    fixture: wolfcert_est_server
    type: multi_line
    ordered: true
    regex:
      - "enrolled: [1-9][0-9]* bytes"
      - "-----BEGIN CERTIFICATE-----"
      - "-----END CERTIFICATE-----"
tests:
  sample.wolfcert.est_client:
    timeout: 120
    platform_allow: qemu_x86
    integration_platforms:
      - qemu_x86
  sample.wolfcert.est_client.custom_ca:
    build_only: true
    platform_allow: qemu_x86
    extra_configs:
      - CONFIG_WOLFCERT_SAMPLE_CA_CERT="../../../examples/certs/mldsa/ca-cert.pem"
  sample.wolfcert.est_client.frdm_mcxn947:
    build_only: true
    platform_allow: frdm_mcxn947/mcxn947/cpu0
    integration_platforms:
      - frdm_mcxn947/mcxn947/cpu0
```

## prj.conf
```kconfig
CONFIG_WOLFSSL=y
CONFIG_WOLFSSL_BUILTIN=y
CONFIG_WOLFSSL_SETTINGS_FILE="wolfcert_sample_settings.h"

CONFIG_WOLFCERT=y
CONFIG_WOLFCERT_EST=y
CONFIG_WOLFCERT_ECC=y

# Boot waits for an IPv4 address before main() runs. zephyr/README.md lists
# what each boards/<board>.conf adds.
CONFIG_NET_IPV4=y
CONFIG_NET_TCP=y
CONFIG_NET_CONFIG_SETTINGS=y
CONFIG_NET_CONFIG_NEED_IPV4=y
CONFIG_NET_PKT_RX_COUNT=32
CONFIG_NET_PKT_TX_COUNT=32
CONFIG_NET_BUF_RX_COUNT=64
CONFIG_NET_BUF_TX_COUNT=64

CONFIG_HW_STACK_PROTECTION=y

CONFIG_PRINTK=y
```

## boards/frdm_mcxn947_mcxn947_cpu0.conf
```kconfig
# ENET QoS on the RJ45 port, addressed by DHCPv4.
CONFIG_NET_L2_ETHERNET=y
CONFIG_NET_DHCPV4=y

CONFIG_MAIN_STACK_SIZE=8192
CONFIG_HEAP_MEM_POOL_SIZE=16384

# Room for the thread-local data; see zephyr/README.md, Sizing.
CONFIG_IDLE_STACK_SIZE=1024
CONFIG_SYSTEM_WORKQUEUE_STACK_SIZE=2048
```

## boards/qemu_x86.conf
```kconfig
# Reach the host through the QEMU SLIRP gateway at 10.0.2.2. SLIRP's topology
# is fixed, so address statically rather than waiting on DHCP.
CONFIG_NET_QEMU_USER=y
CONFIG_PCIE=y
CONFIG_ETH_E1000=y
CONFIG_NET_L2_ETHERNET=y
CONFIG_NET_CONFIG_MY_IPV4_ADDR="10.0.2.15"
CONFIG_NET_CONFIG_MY_IPV4_GW="10.0.2.2"
CONFIG_NET_CONFIG_MY_IPV4_NETMASK="255.255.255.0"

# qemu_x86 has no entropy device. Not a real RNG.
CONFIG_TEST_RANDOM_GENERATOR=y

# Key generation is the deep path; see zephyr/README.md on stack sizing.
CONFIG_MAIN_STACK_SIZE=131072
CONFIG_HEAP_MEM_POOL_SIZE=262144
CONFIG_COMMON_LIBC_MALLOC_ARENA_SIZE=262144
CONFIG_ISR_STACK_SIZE=4096
CONFIG_IDLE_STACK_SIZE=2048
```

## boards/frdm_mcxn947_mcxn947_cpu0.overlay
```dts
/* SPDX-License-Identifier: GPL-3.0-or-later */

/* Take the MAC from the chip's unique ID, so the board keeps one DHCP lease
 * across resets. */
&enet_mac {
	/delete-property/ zephyr,random-mac-address;
	nxp,unique-mac;
};
```

## src/main.c
```c
/*
 * Copyright (C) 2026 wolfSSL Inc.
 *
 * This file is part of wolfCert.
 *
 * wolfCert is free software; you can redistribute it and/or modify
 * it under the terms of the GNU General Public License as published by
 * the Free Software Foundation; either version 3 of the License, or
 * (at your option) any later version.
 *
 * wolfCert is distributed in the hope that it will be useful,
 * but WITHOUT ANY WARRANTY; without even the implied warranty of
 * MERCHANTABILITY or FITNESS FOR A PARTICULAR PURPOSE.  See the
 * GNU General Public License for more details.
 *
 * You should have received a copy of the GNU General Public License
 * along with wolfCert.  If not, see <http://www.gnu.org/licenses/>.
 */

#include <wolfcert/wolfcert.h>

#include <string.h>
#include <time.h>

#include <zephyr/kernel.h>

/* An empty Kconfig string becomes NULL. */
#define OPT_OR_NULL(s) (sizeof(s) > 1 ? (s) : NULL)

/* EST requires server authentication (RFC 7030 section 3.3). */
static const uint8_t ca_cert_pem[] = {
#include "est_ca_cert.inc"
};

static void log_sink(WolfCertLogLevel level, const char* module,
                     const char* msg, void* ctx)
{
    ARG_UNUSED(level);
    ARG_UNUSED(ctx);
    printk("wolfcert[%s]: %s\n", module, msg);
}

/* WolfCertBuffer is length-delimited; print it in NUL-terminated chunks. */
static void print_pem(const WolfCertBuffer* pem)
{
    char chunk[65];
    size_t off = 0;
    size_t n;

    while (off < pem->len) {
        n = pem->len - off;
        if (n > sizeof(chunk) - 1)
            n = sizeof(chunk) - 1;
        memcpy(chunk, pem->data + off, n);
        chunk[n] = '\0';
        printk("%s", chunk);
        off += n;
    }
    printk("\n");
}

static int enroll(void)
{
    WolfCertServerCfg srv = {
        .protocol          = WOLFCERT_PROTO_EST,
        .server_url        = CONFIG_WOLFCERT_SAMPLE_EST_URL,
        .proto_opts.est    = {
            .username = OPT_OR_NULL(CONFIG_WOLFCERT_SAMPLE_EST_USER),
            .password = OPT_OR_NULL(CONFIG_WOLFCERT_SAMPLE_EST_PASS) },
        .trust_anchors     = ca_cert_pem,
        .trust_anchors_len = sizeof(ca_cert_pem),
        .verify_server     = 1,
    };
    WolfCertKeyCfg key_cfg = { .type = WOLFCERT_KEY_ECC, .param = 256,
                               .dev_id = WOLFCERT_DEVID_SOFTWARE };
    WolfCertCertMeta meta = { .subject_dn = CONFIG_WOLFCERT_SAMPLE_SUBJECT };
    WolfCertClient* client = NULL;
    WolfCertKey* key = NULL;
    WolfCertBuffer cert = { 0 };
    int rc;

    rc = wolfcert_client_new(&client);
    if (rc == WOLFCERT_OK)
        rc = wolfcert_client_enroll(client, &srv, &key_cfg, &meta, &key, &cert);

    if (rc == WOLFCERT_OK) {
        printk("enrolled: %u bytes\n", (unsigned)cert.len);
        print_pem(&cert);
    }
    else {
        printk("enroll failed: %s (%s)\n", wolfcert_strerror(rc),
               wolfcert_last_error_message());
    }

    wolfcert_buffer_free(&cert);
    wolfcert_key_free(key);
    wolfcert_client_free(client);
    return rc;
}

int main(void)
{
    struct timespec ts = { 0 };
    int rc;

    /* Set the clock from the build time. */
    ts.tv_sec = (time_t)WOLFCERT_SAMPLE_EPOCH;
    if (clock_settime(CLOCK_REALTIME, &ts) != 0) {
        printk("clock_settime failed\n");
        k_panic();
    }

    wolfcert_set_log_cb(log_sink, NULL);
    wolfcert_set_log_level(WOLFCERT_LOG_WARN);

    rc = wolfcert_init(NULL);
    if (rc != WOLFCERT_OK) {
        printk("wolfcert_init failed: %s\n", wolfcert_strerror(rc));
        k_panic();
    }

    rc = enroll();
    wolfcert_cleanup();
    if (rc != WOLFCERT_OK)
        k_panic();
    return 0;
}
```
